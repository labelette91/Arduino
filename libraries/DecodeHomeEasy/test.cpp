#if _MSC_VER 

#include "VSPDE.h"
#endif


#include "fifo.h"
TFifo fifo;

#include "DecodeHomeEasy.h"

DecodeHomeEasy orscV2(1);



#define PORT 2

#define ledPin  13

volatile word pulse;

long int 	LastReceive ;
int 		NbReceive;
word 		Dt;
long int 	NbPulse  ;


void setup () {

/*	fifo.Clear();
	fifo.Put(10,(byte*)"toto");
	fifo.Put(10,(byte*)"toto1");
	fifo.Put(10,(byte*)"toto2");
	while (!fifo.Empty())
	{
  			char message[100];
        byte len;

				//rc->getOokCode(message);
        strncpy((char*) message,(const char*)fifo.Get(len),90 ) ;
				printf("%s",message);
	}
	
*/	
	
	
	  LastReceive = 0 ;
	  NbReceive   = 0;
    
    Serial.begin(38400);
//    Serial.println("\n[ookDecoder]");
    
   // initialize the LED pin as an output:
    pinMode(ledPin, OUTPUT);       
    
    pulse=0;
}

#define    BIT_0  300 , 300 ,
#define    BIT_1  300 , 1300 ,
#define    BITS   300 , 2300 ,

#define    BIT0  300 , 300  , 300 , 1300 ,
#define    BIT1  300 , 1300 ,300 , 300 ,

int ConfZ1[]  =  {  BITS BIT0 BIT1 BIT0 BIT1 BIT0 BIT1 BIT0 BIT1 
                         BIT0 BIT1 BIT0 BIT1 BIT0 BIT1 BIT0 BIT1 
                         BIT0 BIT1 BIT0 BIT1 BIT0 BIT1 BIT0 BIT1 
                         BIT0 BIT1 BIT0 BIT1 BIT0 BIT1 BIT0 BIT1 
                    BITS
0,
    };









 int ConfZ2[]  = {
 284  ,
10010,
277  ,
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12942,
0
 };
 int ConfZ3[]  = {

800   ,    
400   ,
000   ,
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500   ,
 	
 	
 	
 	};
 int Z2Eco []  = {0};
 int Z2Conf[]  = {0};
 int Z3Eco []  = {0};
 int Z3Conf[]  = {0};


/*
0704FA00	02208B4E	03827D00	011045A7
0704FA00	02208851	03827D00	01104428
			
0704FA00	02209346	03827D00	011049A3
0704FA00	02209049	03827D00	01104824
			
0704FA00	0220A336	03827D00	0110519B
0704FA00	0220A039	03827D00	0110501C
			
0704FA00	0220CC0D	03827D00	01106606
0704FA00	0220D405	03827D00	01106A02
			
0704FA00	020501F3	03827D00	010280F9
0704FA00	020502F2	03827D00	01028179
0704FA00	020504F0	03827D00	01028278

*/

byte i=0;
byte j=1;
int * conf = ConfZ2;
byte data = 0;
void setPulse()
{

if ( conf[i]!=0)  
{
  pulse = conf[i++]  ;
  if (data==0) data=1;else data=0;
}
else 
{
  orscV2.resetDecoder();		
  data = 0;
  i=0;
  j++;
       if (j==1)
    conf = ConfZ1;
  else if (j==2)
    conf = ConfZ2;
  else if (j==3)
    conf = ConfZ3;
  else if (j==4)
    conf=Z2Eco ;    
  else if (j==5)
    conf=Z2Conf;    
  else if (j==6)
    conf=Z3Eco ;    
  else if (j==7)
    conf=Z3Conf;    
    
}
}

char * state [] = {
"UN",
"T0", 
"T1", 
"T2", 
"T3", 
"OK", 
"DO" };

void printState()
{
  Serial.print("NbPulse ");
  Serial.print(NbPulse,10);

  Serial.print(" state ");
  Serial.print(state[orscV2.state]); 

  Serial.print(" data:");
  Serial.print(data,10);

  Serial.print(" Bits ");
  Serial.print(orscV2.total_bits,10);

  Serial.print(" code:");
  Serial.print(orscV2.CurCode,HEX);

  Serial.print(" p:");
  Serial.print(conf[i-1],10);

  Serial.println();
    

}
void loop () {
    setPulse();
    word p = pulse;
    pulse = 0;
      
    if (p != 0) {
        NbPulse++;
        if (orscV2.nextPulse(p,data))
        {
            Serial.print ("Home:");Serial.print (orscV2.Code,HEX);
    	    NbReceive ++ ;     
            NbPulse=0 ;
           orscV2.resetDecoder();		
                
        }
        printState();    
    }

}


